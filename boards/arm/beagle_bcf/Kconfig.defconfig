## west.yml
```yaml
# The west manifest file for upstream Zephyr.
#
# The per-installation west configuration file, .west/config, sets the
# path to the project containing this file in the [manifest] section's
# "path" variable.
#
# You are free to create your own manifest files and put them in any
# repository you want, to create your own custom Zephyr installations.
# For example, you could create a manifest file in your own out of
# tree application directory, which would pull this zephyr repository
# in as an ordinary project.
#
# You can pass your manifest repositories to west init when creating a
# new Zephyr installation. See the west documentation for more
# information.

manifest:
  defaults:
    remote: upstream

  remotes:
    - name: upstream
      url-base: https://github.com/zephyrproject-rtos
    - name: vaishnavachath
      url-base: https://github.com/vaishnavachath
    - name: jkridner
      url-base: https://git.beagleboard.org/jkridner
    - name: beagleconnect
      url-base: https://git.beagleboard.org/beagleconnect/zephyr
    - name: beagleplay
      url-base: https://git.beagleboard.org/beagleplay/cc1352
    - name: gsoc-greybus
      url-base: https://git.beagleboard.org/gsoc/greybus

  group-filter: [-babblesim]

  #
  # Please add items below based on alphabetical order
  projects:
    - name: cmsis
      revision: 74981bf893e8b10931464b9945e2143d99a3f0a3
      path: modules/hal/cmsis
      groups:
        - hal
    - name: hal_ti
      revision: ae1db23f32dde779cdfc4afaa9a60ea219310a64
      path: modules/hal/ti
      groups:
        - hal
    - name: littlefs
      path: modules/fs/littlefs
      groups:
        - fs
      revision: ca583fd297ceb48bced3c2548600dc615d67af24
    - name: lz4
      revision: 8e303c264fc21c2116dc612658003a22e933124d
      path: modules/lib/lz4
    - name: mbedtls
      revision: 6e7841e5a08eb5da3c82dbc8b6b6d82ae4b7d2a0
      path: modules/crypto/mbedtls
      groups:
        - crypto
    - name: mcuboot
      revision: 74c4d1c52fd51d07904b27a7aa9b2303e896a4e3
      path: bootloader/mcuboot
    - name: net-tools
      revision: e0828aa9629b533644dc96ff6d1295c939bd713c
      path: tools/net-tools
      groups:
        - tools
    - name: picolibc
      path: modules/lib/picolibc
      revision: d07c38ff051386f8e09a143ea0a6c1d6d66dd1d8
    - name: tinycrypt
      revision: 3e9a49d2672ec01435ffbf0d788db6d95ef28de0
      path: modules/crypto/tinycrypt
      groups:
        - crypto
    - name: trusted-firmware-m
      revision: 79a6115d3a8d0e04864ae8156c1dc8532b750f5a
      path: modules/tee/tf-m/trusted-firmware-m
      groups:
        - tee
    - name: zcbor
      revision: 67fd8bb88d3136738661fa8bb5f9989103f4599e
      path: modules/lib/zcbor
    - name: greybus-for-zephyr
      submodules: true
      remote: beagleconnect
      revision: 007582581f675b6c67b3133e0bd5097d73521c5d
      path: modules/greybus
    - name: wpanusb
      remote: beagleplay
      path: modules/wpanusb
      revision: e85d480a636b88d177aa2130f9df05e666c817c0
    - name: micropython
      remote: beagleconnect
      path: modules/micropython
      revision: c40256d06fa60d6b0740a5541bc40094bbb2e053
    - name: arduino-core
      remote: beagleconnect
      path: modules/lib/Arduino-Zephyr-API
      revision: 62c0ed927af7de74523f98e7b96489275cc77330
    - name: ClosedCube_OPT3001_Arduino
      remote: jkridner
      path: modules/lib/ClosedCube_OPT3001_Arduino
      revision: 96eaad9443fc833c08b1b61bb8b54b7acded6e06
    - name: cc1352-firmware
      remote: gsoc-greybus
      path: modules/greybus-host
      revision: c10409a2087911fcc3ccda61dfa145fcdf579546

  self:
    path: zephyr
    west-commands: scripts/west-commands.yml
    import: submanifests
```
