## boards/arm/beagle_bcf/Kconfig.defconfig
```kconfig
# BeagleConnect Freedom board configuration

# Copyright (c) 2020 Erik Larson
# Copyright (c) 2020 Jason Kridner, BeagleBoard.org Foundation
# SPDX-License-Identifier: Apache-2.0

if BOARD_BEAGLECONNECT_FREEDOM

config BOARD
	default "beagleconnect_freedom"

if I2C

config I2C_TS5A2066
	default y

endif # I2C

if SENSOR

config OPT3001
	default y

config TI_HDC20XX
	default y

endif # SENSOR

if FLASH

config SPI_NOR
	default y

config FLASH_MAP
	default y

endif # FLASH

if SERIAL

config PINCTRL
	default y

endif # SERIAL

if SPI

config PINCTRL
	default y

endif # SPI

if PINCTRL

config PINCTRL_DYNAMIC
	default y

config PINCTRL_CC13XX_CC26XX
	default y

endif # PINCTRL

if NETWORKING

CONFIG_IEEE802154=y
CONFIG_NET_PKT_TX_COUNT=6
CONFIG_NET_BUF_DATA_SIZE=128
CONFIG_IEEE802154_CC13XX_CC26XX=y
CONFIG_IEEE802154_CC13XX_CC26XX_SUB_GHZ=y

endif # NETWORKING

endif # BOARD_BEAGLECONNECT_FREEDOM
```

## boards/arm/beagle_bcf/beagleconnect_freedom_defconfig
```kconfig
#
# Copyright (c) 2020 Erik Larson
# Copyright (c) 2020 Jason Kridner, BeagleBoard.org Foundation
#
# SPDX-License-Identifier: Apache-2.0
#

CONFIG_SOC_SERIES_CC13X2X7_CC26X2X7=y
CONFIG_SOC_CC1352P7=y
CONFIG_BOARD_BEAGLECONNECT_FREEDOM=y
CONFIG_BUILD_OUTPUT_HEX=y
# custom callback for the antenna switch
CONFIG_CC13X2_CC26X2_HAS_CUSTOM_RF_HWATTRS=y
CONFIG_CC13X2_CC26X2_BOOTLOADER_ENABLE=y
CONFIG_CC13X2_CC26X2_BOOTLOADER_BACKDOOR_ENABLE=y
CONFIG_CC13X2_CC26X2_BOOTLOADER_BACKDOOR_PIN=15

# Per Seeed recommendation
CONFIG_CC13X2_CC26X2_XOSC_CAPARRAY_DELTA=0xFF

# Enable MPU and hardware stack protection
CONFIG_ARM_MPU=y
CONFIG_HW_STACK_PROTECTION=y

CONFIG_PINCTRL=y
CONFIG_GPIO=y
CONFIG_SERIAL=y
CONFIG_I2C=y
CONFIG_I2C_TS5A2066=y
CONFIG_SPI=y

CONFIG_CONSOLE=y
CONFIG_UART_CONSOLE=y

CONFIG_SENSOR=y
CONFIG_OPT3001=y
CONFIG_TI_HDC20XX=y

CONFIG_BUILD_OUTPUT_HEX=y

CONFIG_HEAP_MEM_POOL_SIZE=1024
#CONFIG_LOG=y
#CONFIG_SHELL=y
CONFIG_FLASH=y
CONFIG_SPI_NOR=y
CONFIG_SPI_NOR_SFDP_RUNTIME=y
CONFIG_FLASH_MAP=y
CONFIG_FLASH_PAGE_LAYOUT=y
CONFIG_FLASH_JESD216_API=y
CONFIG_FILE_SYSTEM=y
#CONFIG_FILE_SYSTEM_SHELL=y
CONFIG_FILE_SYSTEM_LITTLEFS=y
```

## boards/arm/beagle_play_cc1352/Kconfig.defconfig
```kconfig
# BeaglePlay CC1352 board configuration

# Copyright (c) 2022 Jason Kridner, BeagleBoard.org Foundation
# SPDX-License-Identifier: Apache-2.0

if BOARD_BEAGLEPLAY_CC1352

config BOARD
	default "beagleplay_cc1352"

if SERIAL

config PINCTRL
	default y

endif # SERIAL

if PINCTRL

config PINCTRL_DYNAMIC
	default y

config PINCTRL_CC13XX_CC26XX
	default y

endif # PINCTRL

endif # BOARD_BEAGLEPLAY_CC1352
```

## boards/arm/beagle_play_cc1352/beagleplay_defconfig
```kconfig
#
# Copyright (c) 2022 Jason Kridner, BeagleBoard.org Foundation
#
# SPDX-License-Identifier: Apache-2.0
#

CONFIG_SOC_SERIES_CC13X2X7_CC26X2X7=y
CONFIG_SOC_CC1352P7=y
CONFIG_BOARD_BEAGLEPLAY=y
CONFIG_BUILD_OUTPUT_HEX=y
CONFIG_CC13X2_CC26X2_BOOTLOADER_ENABLE=y
CONFIG_CC13X2_CC26X2_BOOTLOADER_BACKDOOR_ENABLE=y
CONFIG_CC13X2_CC26X2_BOOTLOADER_BACKDOOR_PIN=15

# Enable MPU and hardware stack protection
CONFIG_ARM_MPU=y
CONFIG_HW_STACK_PROTECTION=y

CONFIG_PINCTRL=y
CONFIG_GPIO=y
CONFIG_SERIAL=y

CONFIG_CONSOLE=y
CONFIG_UART_CONSOLE=y

CONFIG_BUILD_OUTPUT_HEX=y

CONFIG_LOG=y
CONFIG_SHELL=y
CONFIG_CONSOLE=y

CONFIG_NETWORKING=y
CONFIG_NET_PKT_TX_COUNT=6
CONFIG_NET_BUF_DATA_SIZE=128
CONFIG_NET_CONFIG_SETTINGS=y
CONFIG_NET_CONFIG_AUTO_INIT=n
CONFIG_NET_LOG=y
CONFIG_IEEE802154=y
CONFIG_IEEE802154_DRIVER_LOG_LEVEL_WRN=y
CONFIG_IEEE802154_RAW_MODE=y
CONFIG_IEEE802154_CC13XX_CC26XX=y
CONFIG_IEEE802154_CC13XX_CC26XX_SUB_GHZ=y
CONFIG_IEEE802154_CC13XX_CC26XX_SUB_GHZ_CUSTOM_RADIO_SETUP=y
CONFIG_IEEE802154_CC13XX_CC26XX_SUB_GHZ_CS_THRESHOLD=-20
CONFIG_NET_CONFIG_IEEE802154_CHANNEL=1
CONFIG_NET_CONFIG_IEEE802154_RADIO_TX_POWER=20
```

## boards/arm/beagleconnect_freedom/beagleconnect_freedom_defconfig
```kconfig
#
# Copyright (c) 2020 Erik Larson
# Copyright (c) 2020 Jason Kridner, BeagleBoard.org Foundation
#
# SPDX-License-Identifier: Apache-2.0
#

CONFIG_SOC_SERIES_CC13X2X7_CC26X2X7=y
CONFIG_SOC_CC1352P7=y
CONFIG_BOARD_BEAGLECONNECT_FREEDOM=y
CONFIG_BUILD_OUTPUT_HEX=y
# custom callback for the antenna switch
CONFIG_CC13X2_CC26X2_HAS_CUSTOM_RF_HWATTRS=y
CONFIG_CC13X2_CC26X2_BOOTLOADER_ENABLE=y
CONFIG_CC13X2_CC26X2_BOOTLOADER_BACKDOOR_ENABLE=y
CONFIG_CC13X2_CC26X2_BOOTLOADER_BACKDOOR_PIN=15

# Enable MPU and hardware stack protection
CONFIG_ARM_MPU=y
CONFIG_HW_STACK_PROTECTION=y

CONFIG_PINCTRL=y
CONFIG_GPIO=y
CONFIG_SERIAL=y
CONFIG_I2C=y
CONFIG_I2C_TS5A2066=y
CONFIG_SPI=y

CONFIG_CONSOLE=y
CONFIG_UART_CONSOLE=y

CONFIG_SENSOR=y
CONFIG_OPT3001=y
CONFIG_LIS2DH=y
CONFIG_LIS2DH_OPER_MODE_LOW_POWER=n
CONFIG_TI_HDC20XX=y

CONFIG_BUILD_OUTPUT_HEX=y

CONFIG_LOG=y
CONFIG_SHELL=y
CONFIG_CONSOLE=y
# CONFIG_FLASH=y
# CONFIG_SPI_NOR=y
# CONFIG_FLASH_PAGE_LAYOUT=y
```

## boards/arm/cc1352p1_launchxl/dts/bindings/ti,antenna-mux.yaml
```yaml
# Copyright (c) 2022 Stancu Florin
# SPDX-License-Identifier: Apache-2.0

description: TI CC1352P1 LaunchXL Board Antenna switch

compatible: "ti,antenna-mux"

include: [pinctrl-device.yaml, base.yaml]

properties:
  gpios:
    type: phandle-array
    required: true
    description: Antenna mux control pins
```

## boards/arm/cc1352p7_launchxl/Kconfig.board
```kconfig
# TI CC1352P7 LaunchXL board

# Copyright (c) 2022 Vaishnav Achath
# SPDX-License-Identifier: Apache-2.0

config BOARD_CC1352P7_LAUNCHXL
	bool "TI CC1352P7 LaunchXL"
	depends on SOC_CC1352P7

if BOARD_CC1352P7_LAUNCHXL

config BOARD_ANTENNA_INIT_PRIO
	int "Board antenna switch initialization priority"
	default 70
	help
	  Set the priority for board init, must be greater than
	  KERNEL_INIT_PRIORITY_DEVICE but smaller than
	  IEEE802154_CC13XX_CC26XX_SUB_GHZ_INIT_PRIO.

endif # BOARD_CC1352P7_LAUNCHXL
```

## boards/arm/cc1352p7_launchxl/Kconfig.defconfig
```kconfig
# TI CC1352P7 LaunchXL board

# Copyright (c) 2022 Vaishnav Achath
# SPDX-License-Identifier: Apache-2.0

if BOARD_CC1352P7_LAUNCHXL

config BOARD
	default "cc1352p7_launchxl"

endif # BOARD_CC1352P7_LAUNCHXL
```

## boards/arm/cc1352r7_launchxl/Kconfig.board
```kconfig
# TI CC1352R LaunchXL board

# Copyright (c) 2022 Vaishnav Achath
# SPDX-License-Identifier: Apache-2.0

config BOARD_CC1352R7_LAUNCHXL
	bool "TI CC1352R7 LaunchXL"
	depends on SOC_CC1352R7
```

## boards/arm/cc1352r7_launchxl/Kconfig.defconfig
```kconfig
# TI CC1352R7 LaunchXL board

# Copyright (c) 2022 Vaishnav Achath
# SPDX-License-Identifier: Apache-2.0

if BOARD_CC1352R7_LAUNCHXL

config BOARD
	default "cc1352r7_launchxl"

endif # BOARD_CC1352R7_LAUNCHXL
```

## boards/arm64/beagle_play_am62_a53/Kconfig.board
```kconfig
# Copyright (c) 2023 Jason Kridner, BeagleBoard.org Foundation
# SPDX-License-Identifier: Apache-2.0

config BOARD_BEAGLEPLAY_AM62_A53
	bool "BeagleBoard.org BeaglePlay AM62 A53"
	depends on SOC_SERIES_AM6X_A53
```

## boards/arm64/beagle_play_am62_a53/Kconfig.defconfig
```kconfig
# Copyright (c) 2023 Enphase Energy
# SPDX-License-Identifier: Apache-2.0

if BOARD_BEAGLEPLAY_AM62_A53

config BOARD
	default "beagleplay_am62_a53"

endif # BOARD_BEAGLEPLAY_AM62_A53
```

## boards/arm64/beagle_play_am62_a53/beagleplay_am62_a53_defconfig
```kconfig
# SPDX-License-Identifier: Apache-2.0
CONFIG_AARCH64_IMAGE_HEADER=y
CONFIG_ARMV8_A_NS=y
CONFIG_ARM64_VA_BITS_36=y
CONFIG_ARM64_PA_BITS_36=y
CONFIG_CACHE_MANAGEMENT=y
CONFIG_DCACHE_LINE_SIZE_DETECT=y
CONFIG_ICACHE_LINE_SIZE_DETECT=y
CONFIG_SOC_SERIES_AM6X_A53=y
CONFIG_SOC_AM6254_A53=y
CONFIG_BOARD_BEAGLEPLAY_AM62_A53=y
CONFIG_XIP=n
```

## boards/beagle/beagleconnect_freedom/board.yml
```yaml
boards:
- name: beagleconnect_freedom
  vendor: beagle
  socs:
  - name: cc1352p7
- name: beagleconnect_freedom_c5
  vendor: beagle
  socs:
  - name: cc1352p
```

## boards/beagle/beagleconnect_freedom_c5/Kconfig.beagleconnect_freedom_c5
```kconfig
# BeagleConnect Freedom rev C5 board configuration

# Copyright (c) 2020 Erik Larson
# Copyright (c) 2021 Jason Kridner, BeagleBoard.org Foundation
# SPDX-License-Identifier: Apache-2.0

config BOARD_BEAGLECONNECT_FREEDOM_C5
	select SOC_CC1352P
```

## boards/beagle/beagleconnect_freedom_c5/board.yml
```yaml
board:
- name: beagleconnect_freedom_c5
  vendor: beagle
  socs:
  - name: cc1352p
```

## drivers/sensor/hm3301/Kconfig
```kconfig
# HM3301 particulate mater sensor configuration options

# Copyright (c) 2021 Jason Kridner
# SPDX-License-Identifier: Apache-2.0

menuconfig HM3301
	bool "HM3301 sensor"
	depends on I2C
	help
	  Enable driver for HM3301 I2C-based particulate matter sensor.
```

## dts/bindings/adc/ti,ads1115.yaml
```yaml
# Copyright (c) 2019, Actinius
# Copyright (c) 2021 Jason Kridner, BeagleBoard.org Foundation
# SPDX-License-Identifier: Apache-2.0

description: Texas Instruments ADS1115 analog-to-digital converters

compatible: "ti,ads1115"

include: ti,ads1x1x-base.yaml

# Ultimately, io-channel-cells should be either 1 (single-ended) or 2 (differential)

properties:
    int_gpios:
      type: phandle-array
      required: false
      description: DRDY/INT pin.

        The DRDY/INT pin of ADS1115 sensor is open-drain, active low. If
        connected directly the MCU pin should be configured as pull-up
        as pull-up, active low.

    continuous_mode:
      type: int
      required: true
      description: if continuous_mode equal to false, the device is in single mode. true is in continuous_mode.

    avg_method:
      type: string
      required: false
      enum:
        - "rms"
        - "mean"
      description: method for averaging oversamples
```

## dts/bindings/i2c/ti,ts5a2066.yaml
```yaml
# Copyright (c) 2021, Jason Kridner, BeagleBoard.org Foundation
# SPDX-License-Identifier: Apache-2.0

description: |
  GPIO enabled analog switch to isolate devices from an I2C bus

compatible: "ti,ts5a2066"
include: base.yaml
bus: i2c

properties:
  "#address-cells":
    required: true
    const: 1
  "#size-cells":
    required: true
    const: 0
  controller:
    type: phandle
    required: true
  gpios:
    type: phandle-array
    required: true
  label:
    required: false
```

## samples/subsys/mgmt/mcumgr/smp_svr/boards/beagleconnect_freedom.conf
```kconfig
CONFIG_LOG=y
CONFIG_SHELL=y
CONFIG_I2C_LOG_LEVEL_DBG=y
CONFIG_CONSOLE_SUBSYS=y
CONFIG_CONSOLE_GETCHAR=y
CONFIG_ENTROPY_GENERATOR=y
CONFIG_LED=y
CONFIG_LED_SHELL=y
CONFIG_GPIO_SHELL=y
#CONFIG_FILE_SYSTEM_SHELL=y
CONFIG_SENSOR=y
CONFIG_SENSOR_SHELL=y
CONFIG_IEEE802154=y
CONFIG_NETWORKING=y
CONFIG_NET_ICMPV6_LOG_LEVEL_DBG=y
CONFIG_NET_HOSTNAME_ENABLE=y
CONFIG_NET_IF_UNICAST_IPV6_ADDR_COUNT=3
CONFIG_NET_IF_MCAST_IPV6_ADDR_COUNT=4
CONFIG_NET_IF_MAX_IPV6_COUNT=2
CONFIG_NET_SHELL=y
CONFIG_NET_TCP=y
CONFIG_NET_MAX_CONN=3
CONFIG_NET_MAX_CONTEXTS=5
CONFIG_NET_CONTEXT_NET_PKT_POOL=y
CONFIG_NET_PKT_RX_COUNT=4
CONFIG_NET_BUF_RX_COUNT=32
CONFIG_NET_PKT_TX_COUNT=10
CONFIG_NET_BUF_TX_COUNT=25
CONFIG_NET_STATISTICS=y
CONFIG_NET_LOG=y
CONFIG_MDNS_RESPONDER=y
CONFIG_DNS_SD=y
CONFIG_NET_CONFIG_AUTO_INIT=y
CONFIG_NET_CONFIG_SETTINGS=y
CONFIG_NET_CONFIG_MY_IPV6_ADDR="2001:db8::2"
CONFIG_NET_CONFIG_PEER_IPV6_ADDR="2001:db8::1"
CONFIG_NET_SOCKETS=y
#CONFIG_NET_SOCKETS_POSIX_NAMES=y
CONFIG_NET_SOCKETS_POLL_MAX=8
CONFIG_NET_CONNECTION_MANAGER=y
CONFIG_NET_CONFIG_NEED_IPV6=y
CONFIG_NET_CONFIG_NEED_IPV4=n
CONFIG_NET_L2_IEEE802154=y
CONFIG_NET_L2_IEEE802154_SHELL=y
CONFIG_NET_L2_IEEE802154_LOG_LEVEL_INF=y

CONFIG_IEEE802154_CC13XX_CC26XX=n
CONFIG_IEEE802154_CC13XX_CC26XX_SUB_GHZ=y
CONFIG_NET_CONFIG_IEEE802154_CHANNEL=1
CONFIG_NET_CONFIG_IEEE802154_PAN_ID=0xabcd
CONFIG_NET_CONFIG_IEEE802154_RADIO_TX_POWER=20
CONFIG_IEEE802154_CC13XX_CC26XX_SUB_GHZ_NUM_RX_BUF=6

# Hacks
#CONFIG_NEWLIB_LIBC=y
#CONFIG_POSIX_MAX_FDS=16
#CONFIG_POSIX_CLOCK=y
#CONFIG_PTHREAD_IPC=y
#CONFIG_MAX_PTHREAD_COUNT=4
#CONFIG_PTHREAD_DYNAMIC_STACK=y

# Alter prj.conf
CONFIG_NET_IPV4=n
CONFIG_NET_CONFIG_NEED_IPV4=n
CONFIG_NET_IPV4_AUTO=n
CONFIG_NET_CONFIG_MY_IPV4_ADDR=""
CONFIG_NET_CONFIG_MY_IPV4_GW=""
CONFIG_DNS_SERVER1=""

##########
# MCUmgr #
##########

# Enable mcumgr.
CONFIG_MCUMGR=y

# Some command handlers require a large stack.
CONFIG_SYSTEM_WORKQUEUE_STACK_SIZE=2304
CONFIG_MAIN_STACK_SIZE=2048

# Ensure an MCUboot-compatible binary is generated.
CONFIG_BOOTLOADER_MCUBOOT=y

# Enable flash operations.
CONFIG_FLASH=y

# Required by the `taskstat` command.
#CONFIG_THREAD_MONITOR=y

# Support for taskstat command
#CONFIG_MCUMGR_GRP_OS_TASKSTAT=y

# Enable statistics and statistic names.
#CONFIG_STATS=y
#CONFIG_STATS_NAMES=y

# Enable most core commands.
CONFIG_MCUMGR_GRP_IMG=y
CONFIG_MCUMGR_GRP_OS=y
#CONFIG_MCUMGR_GRP_STAT=y

###############
# More MCUmgr #
###############

# Extra commands and features
#CONFIG_MCUMGR_GRP_SHELL=y
#CONFIG_MCUMGR_GRP_OS_ECHO=y
#CONFIG_SHELL_BACKEND_SERIAL=y
#CONFIG_THREAD_RUNTIME_STATS=y

CONFIG_BASE64=y
CONFIG_CONSOLE=y
CONFIG_UART_CONSOLE=y
CONFIG_UART_CONSOLE_MCUMGR=y
CONFIG_MCUMGR_TRANSPORT_UART=y

# Enable the UDP mcumgr transports.
CONFIG_MCUMGR_TRANSPORT_UDP=y
CONFIG_MCUMGR_TRANSPORT_UDP_IPV6=y

# MCUBOOT signature
CONFIG_MCUBOOT_SIGNATURE_KEY_FILE="bootloader/mcuboot/root-rsa-2048.pem"
```

## soc/arm64/ti_sitara/am6x/Kconfig.defconfig.am6254
```kconfig
# Copyright (c) 2023 Enphase Energy
# Copyright (c) 2023 Jason Kridner, BeagleBoard.org Foundation
# SPDX-License-Identifier: Apache-2.0

if SOC_AM6254_A53

config SOC
	default "am6254"

endif # SOC_AM6254_A53
```
